// These arguments were used when this file was generated. They will be automatically applied on subsequent loads 
// via the GUI or CLI invocations. Run CLI with '--help' for additional information on how to override these arguments.
// @cliArgs --board "/ti/boards/MSP_EXP432P4111" --product "simplelink_msp432p4_sdk@3.30.00.13"
// @versions {"data":"2019083011","timestamp":"2019083011","tool":"1.2.952","templates":"2019083011"}

var RTOS = scripting.addModule("/ti/drivers/RTOS");
var Power = scripting.addModule("/ti/drivers/Power");
var Board = scripting.addModule("/ti/drivers/Board");
var DriverLib = scripting.addModule("/ti/devices/DriverLib");
var LED = scripting.addModule("/ti/drivers/apps/LED");
var LED1 = LED.addInstance();
var LED2 = LED.addInstance();
// Name
RTOS.timer0.resource.$name = "MyTIMER_A1";
// Name
Power.performanceLevel3.$name = "ti_drivers_power_PowerMSP432PerfLevels0";
// Name
Power.performanceLevel2.$name = "ti_drivers_power_PowerMSP432PerfLevels1";
// Name
Power.performanceLevel1.$name = "ti_drivers_power_PowerMSP432PerfLevels2";
// Name
Power.performanceLevel0.$name = "ti_drivers_power_PowerMSP432PerfLevels3";
// Use Hardware - Select the hardware to use, or 'None' to use available header pins
LED1.$hardware = system.deviceData.board.components.LED1_RED;
// Name - The C/C++ identifier used in applications as the index parameter passed to LED runtime APIs
LED1.$name = "CONFIG_LED_Red";
// Mode - Select the GPIO mode
LED1.gpioPin.mode = "Output";
// Callback Function - The name of the callback function called when this GPIO pin triggers an interrupt, or 'NULL' if it's specified at runtime
LED1.gpioPin.callbackFunction = "";
// Use Hardware - Select the hardware to use, or 'None' to use available header pins
LED2.$hardware = system.deviceData.board.components.LED2_GREEN;
// Name - The C/C++ identifier used in applications as the index parameter passed to LED runtime APIs
LED2.$name = "CONFIG_LED_Green";
// Mode - Select the GPIO mode
LED2.gpioPin.mode = "Output";
// Callback Function - The name of the callback function called when this GPIO pin triggers an interrupt, or 'NULL' if it's specified at runtime
LED2.gpioPin.callbackFunction = "";
// Suggest solution
RTOS.timer0.resource.$suggestSolution = "Timer_A0";
// Suggest solution
LED1.gpioPin.gpioPin.$suggestSolution = "4";
// Suggest solution
LED2.gpioPin.gpioPin.$suggestSolution = "17";
